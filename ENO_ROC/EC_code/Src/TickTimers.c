////////////////////////////////////////////////////////////////////////////////////////////////////
// fileName: TickTimers.c
//
// Description: Set up and decrements any active 1mS 'tick' timers
//
// Author: Enovation controls
//
//         http://www.enovationcontrols.com
//
// copyright Copyright 2024 by Enovation Controls.
//            This file and/or parts of it are subject to
//            software license terms.
//
//            Without written approval of Enovation Controls this
//            software may not be copied, redistributed or used
//            in any other way.
//
////////////////////////////////////////////////////////////////////////////////////////////////////

////////////////////////////////////////////////////////////////////////////////////////////////////
// Includes
////////////////////////////////////////////////////////////////////////////////////////////////////
#include <stdbool.h>
#include <stdint.h>
#include "TickTimers.h"
#include "CAN.h"


////////////////////////////////////////////////////////////////////////////////////////////////////
//Defines
////////////////////////////////////////////////////////////////////////////////////////////////////


////////////////////////////////////////////////////////////////////////////////////////////////////
// Typedefs
////////////////////////////////////////////////////////////////////////////////////////////////////


////////////////////////////////////////////////////////////////////////////////////////////////////
// Private variables
////////////////////////////////////////////////////////////////////////////////////////////////////


////////////////////////////////////////////////////////////////////////////////////////////////////
// Private interface
////////////////////////////////////////////////////////////////////////////////////////////////////


////////////////////////////////////////////////////////////////////////////////////////////////////
// Public interface
////////////////////////////////////////////////////////////////////////////////////////////////////
uint16_t const DISPLAY_UPDATE_RATE = 50;
uint16_t  REGEN_BUTTON_PRESSED_TIME = 1500;		//mS.  Time button high-light colour dissappears for each time a regen button is pressed

uint16_t can_rx_timer;
uint16_t can_tx_timer;

uint16_t lcd_heater_timer;
uint16_t lcd_heater_PWM_timer;



////////////////////////////////////////////////////////////////////////
//
// initialise_timers()
//
// Sets 1mS 'tick' timers on power up

//    Returns:
//		none
//
////////////////////////////////////////////////////////////////////////
void initialise_timers()
{
	can_rx_timer = 0;
	can_tx_timer = 0;
	lcd_heater_timer = 1000;
	lcd_heater_PWM_timer = 0;
}


////////////////////////////////////////////////////////////////////////
//
// update_tick_timers()
//
// Decrements any 1mS 'tick' timers that are currently running.  This
//routine is called every 1mS//
//    Returns:
//		none
//
////////////////////////////////////////////////////////////////////////
void update_tick_timers()
{
	//Global CAN RX timeout
	if(can_rx_timer != 0)
		--can_rx_timer;

	//CAN TX timer
	if(can_tx_timer != 0)
			--can_tx_timer;

	if(lcd_heater_timer != 0)
		--lcd_heater_timer;

	if(lcd_heater_PWM_timer != 0)
		--lcd_heater_PWM_timer;
}

